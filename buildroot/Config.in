## buildroot/Config.in
```kconfig
menu "RasPlayer packages"
source "$BR2_EXTERNAL_RASPLAYER_PATH/package/rasplayer/Config.in"
source "$BR2_EXTERNAL_RASPLAYER_PATH/package/python-vlc/Config.in"
source "$BR2_EXTERNAL_RASPLAYER_PATH/package/python-pyfluidsynth/Config.in"
source "$BR2_EXTERNAL_RASPLAYER_PATH/package/python-rasplayer-pygame/Config.in"
endmenu
```

## buildroot/configs/rasplayer_pi3bplus_defconfig
```kconfig
BR2_aarch64=y
BR2_ARM_FPU_VFPV4=y
BR2_PACKAGE_HOST_LINUX_HEADERS_CUSTOM_6_1=y
BR2_TOOLCHAIN_BUILDROOT_CXX=y
BR2_TOOLCHAIN_BUILDROOT_MUSL=y
BR2_TARGET_GENERIC_HOSTNAME="rasplayer"
BR2_TARGET_GENERIC_ISSUE="RasPlayer Buildroot appliance"
# BR2_TARGET_GENERIC_GETTY is not set
BR2_SYSTEM_DHCP=""
# BR2_PACKAGE_IFUPDOWN_SCRIPTS is not set
BR2_ROOTFS_OVERLAY="$(BR2_EXTERNAL_RASPLAYER_PATH)/board/rasplayer-pi3bplus/rootfs-overlay"
BR2_ROOTFS_USERS_TABLES="$(BR2_EXTERNAL_RASPLAYER_PATH)/board/rasplayer-pi3bplus/users.txt"
BR2_ROOTFS_POST_BUILD_SCRIPT="$(BR2_EXTERNAL_RASPLAYER_PATH)/board/rasplayer-pi3bplus/post-build.sh"
BR2_ROOTFS_POST_IMAGE_SCRIPT="$(BR2_EXTERNAL_RASPLAYER_PATH)/board/rasplayer-pi3bplus/post-image.sh"
BR2_LINUX_KERNEL=y
BR2_LINUX_KERNEL_CUSTOM_TARBALL=y
BR2_LINUX_KERNEL_CUSTOM_TARBALL_LOCATION="$(call github,raspberrypi,linux,17f135b742c4edb340afb365873c3a574f7e16cb)/linux-17f135b742c4edb340afb365873c3a574f7e16cb.tar.gz"
BR2_LINUX_KERNEL_DEFCONFIG="bcmrpi3"
BR2_LINUX_KERNEL_CONFIG_FRAGMENT_FILES="$(BR2_EXTERNAL_RASPLAYER_PATH)/board/rasplayer-pi3bplus/kernel.config"
BR2_LINUX_KERNEL_DTS_SUPPORT=y
BR2_LINUX_KERNEL_INTREE_DTS_NAME="broadcom/bcm2710-rpi-3-b broadcom/bcm2710-rpi-3-b-plus broadcom/bcm2837-rpi-3-b"
BR2_LINUX_KERNEL_NEEDS_HOST_OPENSSL=y
BR2_PACKAGE_BUSYBOX_SHOW_OTHERS=y
BR2_PACKAGE_BUSYBOX_CONFIG_FRAGMENT_FILES="$(BR2_EXTERNAL_RASPLAYER_PATH)/board/rasplayer-pi3bplus/busybox.config"
BR2_PACKAGE_ALSA_LIB=y
BR2_PACKAGE_ALSA_UTILS=y
BR2_PACKAGE_ALSA_UTILS_AMIXER=y
BR2_PACKAGE_ALSA_UTILS_APLAY=y
BR2_PACKAGE_MPG123=y
BR2_PACKAGE_PYTHON3=y
BR2_PACKAGE_PYTHON3_PYC_ONLY=y
BR2_PACKAGE_PYTHON_RPI_GPIO=y
BR2_PACKAGE_PYTHON_NUMPY=y
BR2_PACKAGE_PYTHON_SETUPTOOLS=y
BR2_PACKAGE_FLUID_SOUNDFONT=y
BR2_PACKAGE_FLUIDSYNTH=y
BR2_PACKAGE_FLUIDSYNTH_ALSA_LIB=y
# BR2_PACKAGE_FLUIDSYNTH_JACK2 is not set
# BR2_PACKAGE_FLUIDSYNTH_PULSEAUDIO is not set
# BR2_PACKAGE_FLUIDSYNTH_SDL2 is not set
# BR2_PACKAGE_FLUIDSYNTH_DBUS is not set
BR2_PACKAGE_VLC=y
BR2_PACKAGE_XZ=y
BR2_PACKAGE_RPI_FIRMWARE=y
BR2_PACKAGE_RPI_FIRMWARE_BOOTCODE_BIN=y
BR2_PACKAGE_RPI_FIRMWARE_VARIANT_PI=y
BR2_PACKAGE_RPI_FIRMWARE_CONFIG_FILE="$(BR2_EXTERNAL_RASPLAYER_PATH)/board/rasplayer-pi3bplus/config.txt"
BR2_PACKAGE_RPI_FIRMWARE_CMDLINE_FILE="$(BR2_EXTERNAL_RASPLAYER_PATH)/board/rasplayer-pi3bplus/cmdline.txt"
BR2_PACKAGE_BRCMFMAC_SDIO_FIRMWARE_RPI=y
BR2_PACKAGE_BRCMFMAC_SDIO_FIRMWARE_RPI_WIFI=y
BR2_PACKAGE_DROPBEAR=y
BR2_PACKAGE_WPA_SUPPLICANT=y
BR2_PACKAGE_WPA_SUPPLICANT_PASSPHRASE=y
BR2_PACKAGE_WPA_SUPPLICANT_CLI=y
BR2_PACKAGE_WPA_SUPPLICANT_WPA3=y
BR2_PACKAGE_KMOD=y
BR2_PACKAGE_KMOD_TOOLS=y
BR2_PACKAGE_E2FSPROGS=y
BR2_PACKAGE_E2FSPROGS_RESIZE2FS=y
BR2_PACKAGE_PARTED=y
BR2_PACKAGE_RSYNC=y
BR2_TARGET_ROOTFS_EXT2=y
BR2_TARGET_ROOTFS_EXT2_4=y
BR2_TARGET_ROOTFS_EXT2_LABEL="rasplayer-root"
BR2_TARGET_ROOTFS_EXT2_SIZE="768M"
# BR2_TARGET_ROOTFS_TAR is not set
BR2_PACKAGE_HOST_DOSFSTOOLS=y
BR2_PACKAGE_HOST_GENIMAGE=y
BR2_PACKAGE_HOST_KMOD_XZ=y
BR2_PACKAGE_HOST_MTOOLS=y
BR2_PACKAGE_PYTHON_VLC=y
BR2_PACKAGE_PYTHON_PYFLUIDSYNTH=y
BR2_PACKAGE_PYTHON_RASPLAYER_PYGAME=y
BR2_PACKAGE_RASPLAYER=y
```

## buildroot/package/python-pyfluidsynth/Config.in
```kconfig
config BR2_PACKAGE_PYTHON_PYFLUIDSYNTH
	bool "pyfluidsynth binding"
	depends on BR2_PACKAGE_PYTHON3
	depends on BR2_PACKAGE_FLUIDSYNTH
```

## buildroot/package/python-rasplayer-pygame/Config.in
```kconfig
config BR2_PACKAGE_PYTHON_RASPLAYER_PYGAME
	bool "pygame"
	depends on BR2_PACKAGE_PYTHON3
	select BR2_PACKAGE_SDL2
	select BR2_PACKAGE_SDL2_MIXER
	select BR2_PACKAGE_SDL2_IMAGE
	select BR2_PACKAGE_PYTHON_NUMPY
	select BR2_PACKAGE_PYTHON_SETUPTOOLS
```

## buildroot/package/python-vlc/Config.in
```kconfig
config BR2_PACKAGE_PYTHON_VLC
	bool "python-vlc binding"
	depends on BR2_PACKAGE_PYTHON3
	depends on BR2_PACKAGE_VLC
```

## buildroot/package/rasplayer/Config.in
```kconfig
config BR2_PACKAGE_RASPLAYER
	bool "rasplayer application"
	select BR2_PACKAGE_PYTHON3
	select BR2_PACKAGE_MPG123
	select BR2_PACKAGE_ALSA_LIB
	select BR2_PACKAGE_ALSA_UTILS
	select BR2_PACKAGE_PYTHON_RPI_GPIO
	select BR2_PACKAGE_PYTHON_VLC
	select BR2_PACKAGE_PYTHON_PYFLUIDSYNTH
	select BR2_PACKAGE_PYTHON_RASPLAYER_PYGAME
	default y
	help
	  Install the RasPlayer application and its init script.
```
